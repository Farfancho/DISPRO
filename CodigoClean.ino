#include <SPI.h>
#include <Wire.h>
#include <Adafruit_GFX.h>
#include <Adafruit_SSD1306.h>

enum State { MOVING_PLATE, MOVING_TOWER };
State state = MOVING_PLATE;

//Display
#define OLED_MOSI  23
#define OLED_CLK   18
#define OLED_DC    21
#define OLED_CS    5
#define OLED_RESET 19

#define SCREEN_WIDTH 128
#define SCREEN_HEIGHT 64

//Finales De Carrera
#define STOPLOW 22
#define STOPHIGH 32

//Sensor
#define INFRARED 25

//Start 
#define START 33

//Tower
#define DirTower 26
#define stepTower 27

//Plate
#define DirPlate 13
#define stepPlate 14

int Delay = 700;
int stepsPlate = 0;
int stepsTower = 0;
unsigned long previous = 0;
bool stepState = false;

bool start = 0;

Adafruit_SSD1306 display(SCREEN_WIDTH, SCREEN_HEIGHT, &SPI, OLED_DC, OLED_RESET, OLED_CS);

#define FRAME_DELAY (42)
#define FRAME_WIDTH (64)
#define FRAME_HEIGHT (64)
#define FRAME_COUNT (sizeof(frames) / sizeof(frames[0]))
unsigned long previousDisplay = 0;

const byte PROGMEM frames[][512] = {
  {0,0,0,0,0,0,0,0,0,0,0,0,0,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0,0},
  {0,0,0,0,0,0,0,0,0,0,0,0,0,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0,0},
  {0,0,0,0,0,0,0,0,0,0,0,0,0,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0,0},
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  {0,0,0,0,0,0,0,0,0,0,0,0,0,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0,0}
};


void setup() {
  Serial.begin(115200);
  Serial.println("sapo"); //debug porque la esp mandaba basura

  pinMode(STOPHIGH, INPUT_PULLUP); //HIGH = presionado
  pinMode(STOPLOW, INPUT_PULLUP);//HIGH = presionado
  pinMode(START, INPUT_PULLUP);//LOW = presionado

  pinMode(INFRARED, INPUT);

  pinMode(DirTower, OUTPUT);
  pinMode(DirPlate, OUTPUT);
  pinMode(stepTower, OUTPUT);
  pinMode(stepPlate, OUTPUT);

  if (!display.begin(SSD1306_SWITCHCAPVCC)) {
    Serial.println(F("Error al inicializar el display OLED"));
    while (true);  
  }
  displayStartTitle();
}

int frame = 0;

void loop() {

  if(digitalRead(STOPLOW) == HIGH and digitalRead(START) == LOW){
    start = 1;
  }
  if(start == 1){
    displayAnimation();
    moveMotors();
    Serial.println(senseDistance());
    //writeFile();
    if(digitalRead(STOPHIGH) == HIGH){
      start = 0;
      displayFinishTitle();
    }
  }
  if(digitalRead(STOPLOW) == LOW){ //cambiar
    motorDown();
  }
}

void moveMotors(){
  unsigned long current = micros();
  switch(state) {
    case MOVING_PLATE:
      if (stepsPlate < 3200) {
        if (current - previous >= Delay) {
          previous = current;
          digitalWrite(stepPlate, stepState ? LOW : HIGH);
          stepState = !stepState;
          if (!stepState) stepsPlate++; 
        }
      } else {
        stepsPlate = 0;
        state = MOVING_TOWER;
        stepState = false;
        digitalWrite(stepPlate, LOW); 
      }
      break;

    case MOVING_TOWER:
      if (stepsTower < 800) {
        if (current - previous >= Delay) {
          previous = current;
          digitalWrite(stepTower, stepState ? LOW : HIGH);
          stepState = !stepState;
          if (!stepState) stepsTower++; 
        }
      } else {
        stepsTower = 0;
        state = MOVING_PLATE;
        stepState = false;
        digitalWrite(stepTower, LOW); 
      }
      break;
  }


}

float senseDistance() {
  int data = analogRead(INFRARED);
  float voltage = data * (3.3 / 4095.0);
  float distance = 27.86 * pow(voltage, -1.15);

  // Limitar los valores de distancia a un rango razonable
  if (distance > 30.0) {
    distance = 31.0; //debug
  } else if (distance < 7.0) {
    distance = 1.0; //debug
  }

  return distance;
}

void displayAnimation(){
  unsigned long current = millis();
  if(current - previousDisplay >= FRAME_DELAY){ 
    display.clearDisplay();
    display.drawBitmap(32, 0, frames[frame], FRAME_WIDTH, FRAME_HEIGHT, 1);
    display.display();
    frame = (frame + 1) % FRAME_COUNT;
    previousDisplay = current;
  } 
}

void displayStartTitle(){
  display.clearDisplay();
  display.setTextSize(2);      
  display.setTextColor(SSD1306_WHITE);
  display.setCursor(0, 10);
  display.println("3D Scanner");
  display.setTextSize(1);
  display.setCursor(20, 40);
  display.println("Push To Start");
  display.display();
}

void displayFinishTitle(){ //Será cambiado por una animacion de terminado --Oled Star 
  display.clearDisplay();
  display.setTextSize(2);      
  display.setCursor(0, 10);
  display.println("Finished  Scanning");
  display.display();
}

void motorDown(){


}

void writeFile(float distance, float height, float angle){
  if(distance == 1.0 or distance == 31.0){   

  }else{
    Serial.print(distance);
    Serial.print(",");
    Serial.print(height);
    Serial.print(",");
    Serial.println(angle);
  }
}
